## CMakeLists.txt
```
cmake_minimum_required(VERSION 3.20.0)
list(APPEND BOARD_ROOT ${CMAKE_CURRENT_SOURCE_DIR}/..)
list(APPEND DTS_ROOT   ${CMAKE_CURRENT_SOURCE_DIR}/..)
find_package(Zephyr REQUIRED HINTS $ENV{ZEPHYR_BASE})

project(eeg_wearable)

target_sources(app PRIVATE
  src/main.c
  src/ble.c
  src/imu.c
  src/vbat.c
  src/eeg.c
  src/pmic.c
)
```

## prj.conf
```kconfig
CONFIG_GPIO=y
CONFIG_CLOCK_CONTROL_NRF_K32SRC_RC=y
CONFIG_SPI=y
CONFIG_I2C=y
CONFIG_CONSOLE=y
CONFIG_USE_SEGGER_RTT=y
CONFIG_RTT_CONSOLE=y
CONFIG_LOG=y
CONFIG_LOG_BACKEND_RTT=y
CONFIG_SIZE_OPTIMIZATIONS=y

# Stack sizes — nRF54L15 needs larger stacks than Zephyr defaults for BLE
# (sourced from Nordic's own nRF54L15 peripheral sample board configs)
CONFIG_BT_RX_STACK_SIZE=4096
CONFIG_SYSTEM_WORKQUEUE_STACK_SIZE=4096
CONFIG_MAIN_STACK_SIZE=4096

# BLE
CONFIG_BT=y
CONFIG_BT_PERIPHERAL=y
CONFIG_BT_DEVICE_NAME="EEG Wearable"
CONFIG_BT_MAX_CONN=1
# maximum ATT payload size (bytes) — keep <= BT_BUF_ACL_TX_SIZE - 4
CONFIG_BT_L2CAP_TX_MTU=247
CONFIG_BT_BUF_ACL_TX_SIZE=251
CONFIG_BT_BUF_ACL_RX_SIZE=251
# Data Packet Length Extension — NOT auto-enabled here; instead requested
# manually 3 s after connect (see dle_work in ble.c) to avoid 0x23
# LL_PROC_COLLISION with Windows' connection parameter update procedure.
# USER_DATA_LEN_UPDATE exposes bt_conn_le_data_len_update() for manual calls.
CONFIG_BT_USER_DATA_LEN_UPDATE=y
# PHY update — Windows fires its own LL procedures immediately on connect;
# if the nRF also fires an automatic PHY update at the same time the two
# LL procedures collide → 0x23 LL_PROC_COLLISION → disconnect.
# Disable automatic PHY update (same root cause as the DLE workaround above).
CONFIG_BT_AUTO_PHY_UPDATE=n
# number of queued "prepare write" operations
CONFIG_BT_ATT_PREPARE_COUNT=2
# GATT client is required for MTU auto-update (even though we are a peripheral)
CONFIG_BT_GATT_CLIENT=y
# automatically negotiate a larger MTU on connect instead of doing it manually
CONFIG_BT_GATT_AUTO_UPDATE_MTU=y
# NOTIFY_MULTIPLE disabled — when on, Zephyr uses ATT opcode 0x9F
# ("Handle Value Multiple Notification") instead of the standard 0x1B.
# Windows WinRT writes the CSF bit saying it supports 0x9F, so Zephyr uses
# it, but WinRT's CharacteristicValueChanged event does NOT fire for 0x9F —
# only for 0x1B. Result: firmware streams fine (RTT confirms), but every
# packet is silently dropped by WinRT before Python ever sees it.
# iOS handles 0x9F correctly, which is why iPhone works but Windows doesn't.
# CONFIG_BT_GATT_NOTIFY_MULTIPLE is not set
# cosmetic: BLE appearance = "Generic Heart Rate Sensor" (close enough for EEG)
CONFIG_BT_DEVICE_APPEARANCE=833
# Do not bond with clients — avoids Windows WinRT CCCD-write failure caused by
# stale bond state after firmware reflash (device forgets bond, Windows does not).
CONFIG_BT_BONDABLE=n

# ADC — VBAT sense on P1.13
CONFIG_ADC=y

# Ring buffer — used by the ADS1299 EEG driver to queue samples between
# the DRDY workqueue handler and the main loop BLE drain.
CONFIG_RING_BUFFER=y

# Device Runtime PM — required for TWIM22 on nRF54L15.
# The nRF54L15 DTSI has zephyr,pm-device-runtime-auto on TWIM22, which means
# the driver applies the sleep pinctrl state (PSEL disconnected) at init, and
# only connects PSEL to the physical pins on device resume. Without these two
# options the resume never happens and the I2C pins are never driven.
CONFIG_PM_DEVICE=y
CONFIG_PM_DEVICE_RUNTIME=y

# I2C shell — disabled (IMU confirmed working, shell polling thread wastes power)
# Re-enable CONFIG_SHELL + CONFIG_I2C_SHELL for diagnostics if needed

# IMU — LIS2DW12 via raw I2C (imu.c talks directly to i2c22, no sensor driver).
# The Zephyr LIS2DW12 / ST sensor driver is intentionally disabled:
#   - driver init assumptions (power-mode enum, deferred-init) caused silent
#     device_is_ready() failures on this custom board
#   - raw I2C gives explicit WHO_AM_I confirmation and direct register control
# DTS node has status = "disabled" to prevent driver probe at boot.
# CONFIG_SENSOR and CONFIG_LIS2DW12 are deliberately not set.
# I2C debug logging — disabled for sleep test (was firing 25x/s for IMU reads, preventing deep sleep)
CONFIG_I2C_LOG_LEVEL_WRN=y
# RTT Viewer
# channel 0 = log output
```

## src/main.c
```c
#include <zephyr/kernel.h>
#include <zephyr/drivers/gpio.h>
#include <zephyr/sys/atomic.h>
#include <zephyr/sys/byteorder.h>
#include <zephyr/logging/log.h>
#include "ble.h"
#include "imu.h"
#include "vbat.h"
#include "eeg.h"
#include "pmic.h"

LOG_MODULE_REGISTER(main, LOG_LEVEL_INF);

#define LED0_NODE DT_ALIAS(led0)
static const struct gpio_dt_spec led = GPIO_DT_SPEC_GET(LED0_NODE, gpios);

/* ---------- LED error flag ----------
 *
 * Set once by led_set_error() on any init failure.
 * Sticky - never clears. LED thread enters fast-blink forever.
 */
static ATOMIC_DEFINE(led_error_flag, 1);

static void led_set_error(void)
{
    atomic_set_bit(led_error_flag, 0);
}

/* ---------- LED thread ----------
 *
 * State priority (highest → lowest):
 *   Error       → fast blink  100 ms ON / 100 ms OFF  (sticky)
 *   Connected   → solid on
 *   Advertising → breathing   smooth 0→100→0 % duty over ~3 s
 *
 * To use a heartbeat instead of breathing while advertising:
 *   comment out the "BREATHING" block and uncomment the "HEARTBEAT" block.
 */

#define LED_STACK_SIZE  512
#define LED_PRIORITY    7

/* Breathing: 100 Hz PWM carrier (10 ms period) with 10 brightness levels.
 * 15 carrier cycles per level × 10 levels × 2 halves × 10 ms = 3000 ms/cycle.
 * 100 Hz is above the ~60 Hz human flicker-fusion threshold → no visible blink. */
#define BREATH_PERIOD_MS   10   /* PWM carrier period — must be < 16 ms (>60 Hz) */
#define BREATH_STEPS       10   /* brightness levels: step 0 (off) … 10 (full on) */
#define BREATH_HOLD_CYCLES 15   /* carrier cycles to hold each level */

K_THREAD_STACK_DEFINE(led_stack, LED_STACK_SIZE);
static struct k_thread led_thread_data;

static void led_thread(void *p1, void *p2, void *p3)
{
    ARG_UNUSED(p2);
    ARG_UNUSED(p3);

    const struct gpio_dt_spec *l = p1;
    int  step         = 0;
    bool rising       = true;
    bool was_connected = false;

    while (1) {
        /* --- ERROR: fast blink, never exits --- */
        if (atomic_test_bit(led_error_flag, 0)) {
            gpio_pin_set_dt(l, 1);
            k_msleep(100);
            gpio_pin_set_dt(l, 0);
            k_msleep(100);
            continue;
        }

        /* --- CONNECTED: very dim (step 1 / 10% duty) to show we're alive --- */
        if (ble_is_connected()) {
            gpio_pin_set_dt(l, 1);
            k_msleep(1);
            gpio_pin_set_dt(l, 0);
            k_msleep(9);
            was_connected = true;
            continue;
        }

        /* Reset breathing phase when coming back from connected */
        if (was_connected) {
            step          = 0;
            rising        = true;
            was_connected = false;
        }

        /* --- ADVERTISING --- */


        /* -- BREATHING: triangle-wave software PWM --
         * step 0 → 0 % duty (off), step BREATH_STEPS → 100 % (full on).
         * Each step holds for BREATH_HOLD_CYCLES × BREATH_PERIOD_MS ms so the
         * PWM carrier runs at 100 Hz — invisible to the naked eye.  */

        int on_ms  = (step * BREATH_PERIOD_MS) / BREATH_STEPS;
        int off_ms = BREATH_PERIOD_MS - on_ms;

        for (int c = 0; c < BREATH_HOLD_CYCLES; c++) {
            if (on_ms > 0) {
                gpio_pin_set_dt(l, 1);
                k_msleep(on_ms);
            }
            if (off_ms > 0) {
                gpio_pin_set_dt(l, 0);
                k_msleep(off_ms);
            }
        }

        if (rising) {
            if (++step >= BREATH_STEPS) rising = false;
        } else {
            if (--step <= 0)            rising = true;
        }
    }
}

/* ---------- Main ---------- */

int main(void)
{
    int ret;
    bool imu_ok  = false;
    bool vbat_ok = false;
    bool eeg_ok  = false;
    bool pmic_ok = false;

    /* ------------------------------------------------------------------ */
    /* Give RTT viewer 3 s to connect before boot logs scroll past.       */
    //k_msleep(3000);
    LOG_INF("=== EEG Wearable booting ===");
    /* ------------------------------------------------------------------ */

    /* --- LED GPIO --- */
    if (!gpio_is_ready_dt(&led)) {
        LOG_ERR("[LED] GPIO not ready - halting");
        return -ENODEV;
    }
    ret = gpio_pin_configure_dt(&led, GPIO_OUTPUT_INACTIVE);
    if (ret < 0) {
        LOG_ERR("[LED] configure failed (%d) - halting", ret);
        return ret;
    }
    LOG_INF("[LED] OK");

    /* --- LED thread --- */
    k_thread_create(&led_thread_data, led_stack,
                    K_THREAD_STACK_SIZEOF(led_stack),
                    led_thread, (void *)&led, NULL, NULL,
                    LED_PRIORITY, 0, K_NO_WAIT);
    k_thread_name_set(&led_thread_data, "led");

    /* --- BLE --- */
    ret = ble_init();
    if (ret) {
        LOG_ERR("[BLE] init failed (%d) - halting", ret);
        led_set_error();
        return ret;
    }
    LOG_INF("[BLE] OK - advertising as \"EEG Wearable\"");

    /* --- IMU (LIS2DW12) --- */
    ret = imu_init();
    if (ret == 0) {
        imu_ok = true;
        LOG_INF("[IMU] OK - LIS2DW12 ready, polling @ 25 Hz");
    } else {
        LOG_WRN("[IMU] not available (err %d) - continuing", ret);
    }

    /* --- VBAT ADC --- */
    ret = vbat_init();
    if (ret == 0) {
        vbat_ok = true;
        LOG_INF("[VBAT] OK - P1.13/AIN6, 2M+1M divider, LiPo curve");
    } else {
        LOG_WRN("[VBAT] not available (err %d) - continuing", ret);
    }

    /* --- PMIC status GPIOs --- */
    ret = pmic_init();
    if (ret == 0) {
        pmic_ok = true;
        LOG_INF("[PMIC] OK - CHG=P0.03  ERR=P0.02  (internal pull-ups, active-low)");
    } else {
        LOG_WRN("[PMIC] not available (err %d) - continuing without PMIC status", ret);
    }

    /* --- ADS1299 EEG AFE --- */
    ret = eeg_init();
    if (ret == 0) {
        eeg_ok = true;
        LOG_INF("[EEG] OK - ADS1299 streaming at 250 SPS");
    } else {
        LOG_WRN("[EEG] not available (err %d) - continuing without EEG", ret);
    }

    LOG_INF("Boot complete. IMU=%s  VBAT=%s  EEG=%s  PMIC=%s",
            imu_ok  ? "yes" : "no",
            vbat_ok ? "yes" : "no",
            eeg_ok  ? "yes" : "no",
            pmic_ok ? "yes" : "no");
    LOG_INF("Waiting for BLE connection...");

    /* ------------------------------------------------------------------ */
    /* Main loop - 250 Hz tick (4 ms)                                      */
    /*                                                                     */
    /* - Drains 8-sample batches from the ADS1299 ring buffer and notifies */
    /*   over BLE EEG characteristic (~31 Hz packet rate, 195 bytes each). */
    /* - Samples IMU at 25 Hz and notifies over BLE IMU characteristic.    */
    /* - Logs a short status snapshot every 5 s over RTT.                  */
    /* ------------------------------------------------------------------ */

    struct eeg_sample eeg_batch[EEG_BATCH_SIZE];
    uint8_t  eeg_packet[EEG_PACKET_BYTES];
    uint32_t log_tick = 0;   /* increments every 4 ms, logs every 1250 = 5 s */
    uint32_t imu_tick = 0;   /* increments every 4 ms, samples every 10 = 40 ms */

    /* ADS1299 power state machine.
     *   RUNNING: START=1, RDATAC active, 250 SPS, ~6.5 mA
     *   STOPPED: START=0, analog stays on, ~2-3 mA, instant resume
     *   DOWN:    PWDN=1, ~65 µA, full re-init needed on reconnect
     *
     * Transitions:
     *   Boot (no connection) → eeg_stop()     → STOPPED  (30 s countdown starts immediately)
     *   BLE disconnect       → eeg_stop()     → STOPPED
     *   30 s idle            → eeg_powerdown() → DOWN
     *   BLE reconnect (from STOPPED) → eeg_start()   → RUNNING
     *   BLE reconnect (from DOWN)    → eeg_powerup() → RUNNING
     */
    typedef enum { EEG_PWR_RUNNING, EEG_PWR_STOPPED, EEG_PWR_DOWN } eeg_pwr_t;

    /* Start stopped so the 30 s idle countdown begins immediately on boot
     * rather than waiting for a connect-then-disconnect cycle first. */
    eeg_pwr_t eeg_pwr  = EEG_PWR_DOWN;
    if (eeg_ok) {
        eeg_stop();
        eeg_pwr = EEG_PWR_STOPPED;
        LOG_INF("[PWR] Boot with no connection — ADS1299 stopped, 30 s countdown started");
    }
    bool     conn_prev = false;      /* BLE state last iteration */
    uint32_t idle_tick = 0;          /* ticks since boot / last disconnect */

    while (1) {
        /* EEG — always drain the ring buffer so it never overflows when
         * disconnected. Only pack and notify when actually subscribed. */
        if (eeg_is_ready()) {
            int n = eeg_read(eeg_batch, EEG_BATCH_SIZE);
            if (n == EEG_BATCH_SIZE && ble_eeg_subscribed()) {
                eeg_pack_batch(eeg_batch, eeg_packet);
                ble_notify_eeg(eeg_packet, sizeof(eeg_packet));
            }
        }

        /* IMU sample at 25 Hz */
        if (++imu_tick >= 10) {
            imu_tick = 0;
            if (ble_imu_subscribed() && imu_is_ready()) {
                struct imu_sample s;
                if (imu_read(&s) == 0) {
                    ble_notify_imu(&s);
                }
            }
        }

        /* 5 s status snapshot - one block of RTT output, not continuous */
        if (++log_tick >= 1250) {
            log_tick = 0;

            /* BLE state */
            if (ble_eeg_subscribed()) {
                LOG_INF("[STATUS] BLE: streaming EEG | gains=[%u,%u,%u,%u] SPS=250",
                        eeg_get_group_gain(0), eeg_get_group_gain(1),
                        eeg_get_group_gain(2), eeg_get_group_gain(3));
            } else if (ble_is_connected()) {
                LOG_INF("[STATUS] BLE: connected  | waiting for subscription");
            } else {
                LOG_INF("[STATUS] BLE: advertising");
            }

            /* IMU - one raw sample to show it's alive */
            if (imu_ok && imu_is_ready()) {
                struct imu_sample s;
                if (imu_read(&s) == 0) {
                    LOG_INF("[STATUS] IMU: x=%4d  y=%4d  z=%4d mg  "
                            "temp=%d.%02d C",
                            s.x_mg, s.y_mg, s.z_mg,
                            s.temp_cdeg / 100, s.temp_cdeg % 100);
                }
            }

            /* VBAT - voltage and percentage */
            uint32_t vbat_mv  = 0;
            uint8_t  vbat_pct = 0;
            if (vbat_ok) {
                if (vbat_read_mv(&vbat_mv) == 0 && vbat_percent(&vbat_pct) == 0) {
                    LOG_INF("[STATUS] VBAT: %u mV  %u %%", vbat_mv, vbat_pct);
                }
            }

            /* PMIC - charging and error flags */
            bool chg = pmic_ok && pmic_is_charging();
            bool err = pmic_ok && pmic_is_error();
            if (pmic_ok) {
                LOG_INF("[STATUS] PMIC: %s%s",
                        chg ? "CHARGING " : "",
                        err ? "ERROR"     : (chg ? "" : "idle"));
            }

            /* Push to BLE status characteristic if subscribed */
            if (ble_status_subscribed()) {
                ble_notify_status((uint16_t)vbat_mv, vbat_pct, chg, err);
            }

        }

        /* ADS1299 power management — run once per 4 ms tick */
        if (eeg_ok) {
            bool conn_now = ble_is_connected();

            if (conn_prev && !conn_now) {
                /* BLE just disconnected — stop conversions immediately */
                eeg_stop();
                eeg_pwr   = EEG_PWR_STOPPED;
                idle_tick = 0;
                LOG_INF("[PWR] BLE disconnected — ADS1299 stopped (START=0)");

            } else if (!conn_now && eeg_pwr == EEG_PWR_STOPPED) {
                /* Still disconnected — count toward 30 s power-down */
                if (++idle_tick >= 7500) {   /* 7500 × 4 ms = 30 s */
                    eeg_powerdown();
                    eeg_pwr = EEG_PWR_DOWN;
                    LOG_INF("[PWR] 30 s idle — ADS1299 powered down (~65 µA)");
                }

            } else if (!conn_prev && conn_now) {
                /* BLE just reconnected */
                if (eeg_pwr == EEG_PWR_STOPPED) {
                    eeg_start();
                    eeg_pwr = EEG_PWR_RUNNING;
                    LOG_INF("[PWR] BLE reconnected — ADS1299 restarted (instant)");
                } else if (eeg_pwr == EEG_PWR_DOWN) {
                    if (eeg_powerup() == 0) {
                        eeg_pwr = EEG_PWR_RUNNING;
                        LOG_INF("[PWR] BLE reconnected — ADS1299 powered up");
                    } else {
                        LOG_ERR("[PWR] ADS1299 power-up failed — EEG unavailable");
                    }
                }
                idle_tick = 0;
            }

            conn_prev = conn_now;
        }

        k_msleep(4); /* 250 Hz */
    }

    return 0;
}
```

## src/ble.c
```c
#include "ble.h"
#include "imu.h"
#include "eeg.h"

#include <zephyr/sys/byteorder.h>

#include <zephyr/bluetooth/bluetooth.h>
#include <zephyr/bluetooth/hci.h>
#include <zephyr/bluetooth/conn.h>
#include <zephyr/bluetooth/uuid.h>
#include <zephyr/bluetooth/gatt.h>
#include <zephyr/logging/log.h>

LOG_MODULE_REGISTER(ble, LOG_LEVEL_INF);

/* ---------- UUIDs ---------- */

/* EEG Service:      12340001-1234-1234-1234-123456789abc */
/* EEG Data Char:    12340002-1234-1234-1234-123456789abc */
/* IMU Data Char:    12340003-1234-1234-1234-123456789abc */
/* Gain Control:     12340004-1234-1234-1234-123456789abc */
/* Device Status:    12340005-1234-1234-1234-123456789abc */

#define BT_UUID_EEG_SVC_VAL \
    BT_UUID_128_ENCODE(0x12340001, 0x1234, 0x1234, 0x1234, 0x123456789abcULL)
#define BT_UUID_EEG_DATA_VAL \
    BT_UUID_128_ENCODE(0x12340002, 0x1234, 0x1234, 0x1234, 0x123456789abcULL)
#define BT_UUID_IMU_DATA_VAL \
    BT_UUID_128_ENCODE(0x12340003, 0x1234, 0x1234, 0x1234, 0x123456789abcULL)
#define BT_UUID_CTRL_VAL \
    BT_UUID_128_ENCODE(0x12340004, 0x1234, 0x1234, 0x1234, 0x123456789abcULL)
#define BT_UUID_STATUS_VAL \
    BT_UUID_128_ENCODE(0x12340005, 0x1234, 0x1234, 0x1234, 0x123456789abcULL)

static struct bt_uuid_128 eeg_svc_uuid    = BT_UUID_INIT_128(BT_UUID_EEG_SVC_VAL);
static struct bt_uuid_128 eeg_data_uuid   = BT_UUID_INIT_128(BT_UUID_EEG_DATA_VAL);
static struct bt_uuid_128 imu_data_uuid   = BT_UUID_INIT_128(BT_UUID_IMU_DATA_VAL);
static struct bt_uuid_128 ctrl_uuid       = BT_UUID_INIT_128(BT_UUID_CTRL_VAL);
static struct bt_uuid_128 status_uuid     = BT_UUID_INIT_128(BT_UUID_STATUS_VAL);

/* ---------- State ---------- */

static struct bt_conn *current_conn;
static bool eeg_subscribed;
static bool imu_subscribed;
static bool status_subscribed;

/* ---------- GATT service ---------- */

static void eeg_ccc_changed(const struct bt_gatt_attr *attr, uint16_t value)
{
    eeg_subscribed = (value & BT_GATT_CCC_NOTIFY) != 0;
    LOG_INF("EEG notify %s", eeg_subscribed ? "enabled" : "disabled");
}

static void imu_ccc_changed(const struct bt_gatt_attr *attr, uint16_t value)
{
    imu_subscribed = (value & BT_GATT_CCC_NOTIFY) != 0;
    LOG_INF("IMU notify %s", imu_subscribed ? "enabled" : "disabled");
}

static void status_ccc_changed(const struct bt_gatt_attr *attr, uint16_t value)
{
    status_subscribed = (value & BT_GATT_CCC_NOTIFY) != 0;
    LOG_INF("Status notify %s", status_subscribed ? "enabled" : "disabled");
}

/* ---------- Gain control write ----------
 *
 * The Python visualizer writes one byte (gain ∈ {1,2,4,6,8,12,24}) to the
 * Control characteristic (UUID 12340004) to change the ADS1299 PGA gain.
 *
 * The GATT write callback runs in the BLE RX thread; SPI must not be called
 * there.  We store the requested gain and post a k_work item so that
 * eeg_set_gain() runs in the system workqueue — the same queue as the DRDY
 * work handler — and the two SPI users are naturally serialised.
 */
static struct k_work  gain_work;
static uint8_t        pending_gain;
static uint8_t        pending_group;

static void gain_work_handler(struct k_work *work)
{
    ARG_UNUSED(work);
    if (!eeg_is_ready()) {
        LOG_WRN("Gain write ignored — EEG not ready");
        return;
    }
    eeg_set_group_gain(pending_group, pending_gain);
}

/* ---------- Test mode work ----------
 *
 * Byte 0 = 0xFF in a ctrl_write triggers test mode.
 * Byte 1 = 0x01 → enable internal calibration signal; 0x00 → restore electrode input.
 * Runs in the system workqueue so SPI is safe to call.
 */
static struct k_work test_work;
static bool          pending_test_mode;

static void test_work_handler(struct k_work *work)
{
    ARG_UNUSED(work);
    if (!eeg_is_ready()) {
        LOG_WRN("Test mode write ignored — EEG not ready");
        return;
    }
    eeg_set_test_mode(pending_test_mode);
}

/* ---------- DRL toggle work ----------
 *
 * Byte 0 = 0xFE in a ctrl_write toggles the Driven Right Leg circuit.
 * Byte 1 = 0x01 → enable DRL; 0x00 → disable (BIAS amp input disconnected).
 * Runs in the system workqueue so SPI is safe to call.
 */
static struct k_work drl_work;
static bool          pending_drl;

static void drl_work_handler(struct k_work *work)
{
    ARG_UNUSED(work);
    if (!eeg_is_ready()) {
        LOG_WRN("DRL write ignored — EEG not ready");
        return;
    }
    eeg_set_drl(pending_drl);
}

static ssize_t ctrl_write(struct bt_conn *conn, const struct bt_gatt_attr *attr,
                           const void *buf, uint16_t len,
                           uint16_t offset, uint8_t flags)
{
    ARG_UNUSED(attr);
    ARG_UNUSED(flags);

    if (offset != 0) {
        return BT_GATT_ERR(BT_ATT_ERR_INVALID_OFFSET);
    }
    if (len != 2) {
        return BT_GATT_ERR(BT_ATT_ERR_INVALID_ATTRIBUTE_LEN);
    }

    uint8_t grp = ((const uint8_t *)buf)[0];
    uint8_t g   = ((const uint8_t *)buf)[1];

    /* 0xFF = test mode command; byte 1 = 0 (disable) or 1 (enable). */
    if (grp == 0xFF) {
        if (g != 0 && g != 1) {
            LOG_WRN("Test mode rejected: byte 1 must be 0 or 1, got %u", g);
            return BT_GATT_ERR(BT_ATT_ERR_VALUE_NOT_ALLOWED);
        }
        pending_test_mode = (g == 1);
        k_work_submit(&test_work);
        LOG_INF("Test mode request: %s", g ? "enable" : "disable");
        return (ssize_t)len;
    }

    /* 0xFE = DRL toggle command; byte 1 = 0 (disable) or 1 (enable). */
    if (grp == 0xFE) {
        if (g != 0 && g != 1) {
            LOG_WRN("DRL toggle rejected: byte 1 must be 0 or 1, got %u", g);
            return BT_GATT_ERR(BT_ATT_ERR_VALUE_NOT_ALLOWED);
        }
        pending_drl = (g == 1);
        k_work_submit(&drl_work);
        LOG_INF("DRL request: %s", g ? "enable" : "disable");
        return (ssize_t)len;
    }

    if (grp >= 4) {
        LOG_WRN("Gain write rejected: group %u out of range (0–3)", grp);
        return BT_GATT_ERR(BT_ATT_ERR_VALUE_NOT_ALLOWED);
    }

    static const uint8_t valid_gains[] = { 1, 2, 4, 6, 8, 12, 24 };
    bool ok = false;
    for (int i = 0; i < (int)ARRAY_SIZE(valid_gains); i++) {
        if (valid_gains[i] == g) { ok = true; break; }
    }
    if (!ok) {
        LOG_WRN("Gain write rejected: %u not in {1,2,4,6,8,12,24}", g);
        return BT_GATT_ERR(BT_ATT_ERR_VALUE_NOT_ALLOWED);
    }

    pending_group = grp;
    pending_gain  = g;
    k_work_submit(&gain_work);
    LOG_INF("Gain change requested: group %u → %u", grp, g);
    return (ssize_t)len;
}

/*
 * attrs layout:
 *   [0]  primary service declaration
 *   [1]  EEG characteristic declaration
 *   [2]  EEG characteristic value  ← bt_gatt_notify() target for EEG
 *   [3]  EEG CCC descriptor
 *   [4]  IMU characteristic declaration
 *   [5]  IMU characteristic value  ← bt_gatt_notify() target for IMU
 *   [6]  IMU CCC descriptor
 *   [7]  Gain Control characteristic declaration
 *   [8]  Gain Control characteristic value  ← write target
 *   [9]  Device Status characteristic declaration
 *   [10] Device Status characteristic value  ← bt_gatt_notify() target for status
 *   [11] Device Status CCC descriptor
 */
BT_GATT_SERVICE_DEFINE(eeg_svc,
    BT_GATT_PRIMARY_SERVICE(&eeg_svc_uuid),
    BT_GATT_CHARACTERISTIC(&eeg_data_uuid.uuid,
                           BT_GATT_CHRC_NOTIFY,
                           BT_GATT_PERM_NONE,
                           NULL, NULL, NULL),
    BT_GATT_CCC(eeg_ccc_changed, BT_GATT_PERM_READ | BT_GATT_PERM_WRITE),
    BT_GATT_CHARACTERISTIC(&imu_data_uuid.uuid,
                           BT_GATT_CHRC_NOTIFY,
                           BT_GATT_PERM_NONE,
                           NULL, NULL, NULL),
    BT_GATT_CCC(imu_ccc_changed, BT_GATT_PERM_READ | BT_GATT_PERM_WRITE),
    BT_GATT_CHARACTERISTIC(&ctrl_uuid.uuid,
                           BT_GATT_CHRC_WRITE | BT_GATT_CHRC_WRITE_WITHOUT_RESP,
                           BT_GATT_PERM_WRITE,
                           NULL, ctrl_write, NULL),
    BT_GATT_CHARACTERISTIC(&status_uuid.uuid,
                           BT_GATT_CHRC_NOTIFY,
                           BT_GATT_PERM_NONE,
                           NULL, NULL, NULL),
    BT_GATT_CCC(status_ccc_changed, BT_GATT_PERM_READ | BT_GATT_PERM_WRITE),
);

/* ---------- Advertising data ---------- */

/* BT_LE_ADV_CONN was removed in NCS v2.6+ — define params explicitly. */
static const struct bt_le_adv_param adv_param =
    BT_LE_ADV_PARAM_INIT(BT_LE_ADV_OPT_CONN,
                         BT_GAP_ADV_FAST_INT_MIN_2,
                         BT_GAP_ADV_FAST_INT_MAX_2,
                         NULL);

static const struct bt_data ad[] = {
    BT_DATA_BYTES(BT_DATA_FLAGS, BT_LE_AD_GENERAL | BT_LE_AD_NO_BREDR),
    BT_DATA_BYTES(BT_DATA_UUID128_ALL, BT_UUID_EEG_SVC_VAL),
};

static const struct bt_data sd[] = {
    BT_DATA(BT_DATA_NAME_COMPLETE,
            CONFIG_BT_DEVICE_NAME,
            sizeof(CONFIG_BT_DEVICE_NAME) - 1),
};

/* ---------- Advertising work ----------
 * k_work used to restart advertising outside the BLE callback context.
 * Calling bt_le_adv_start() directly from disconnected() is unreliable —
 * the controller is still tearing down the connection when the callback
 * fires, so the call can silently fail. */
static struct k_work adv_work;

static void adv_work_handler(struct k_work *work)
{
    ARG_UNUSED(work);
    int err = bt_le_adv_start(&adv_param, ad, ARRAY_SIZE(ad),
                               sd, ARRAY_SIZE(sd));
    if (err) {
        LOG_ERR("Re-advertising failed (err %d)", err);
    } else {
        LOG_INF("Re-advertising started");
    }
}

/* ---------- Delayed DLE work ----------
 *
 * Windows' BLE stack initiates its own LL procedures (connection parameter
 * update) immediately after connecting.  If the nRF also fires a DLE request
 * at the same time (CONFIG_BT_DATA_LEN_UPDATE auto-behaviour) the two LL
 * procedures collide → 0x23 LL_PROC_COLLISION → disconnect.
 *
 * Fix: disable CONFIG_BT_DATA_LEN_UPDATE and request DLE manually after 3 s,
 * by which point Windows has finished all its own LL procedures.
 * Android/iOS are unaffected — they handle the collision gracefully.
 */
static struct k_work_delayable dle_work;

static void dle_work_handler(struct k_work *work)
{
    ARG_UNUSED(work);
    if (!current_conn) {
        return;
    }
    struct bt_conn_le_data_len_param param = {
        .tx_max_len  = BT_GAP_DATA_LEN_MAX,
        .tx_max_time = BT_GAP_DATA_TIME_MAX,
    };
    int err = bt_conn_le_data_len_update(current_conn, &param);
    if (err) {
        LOG_WRN("DLE update failed (%d)", err);
    } else {
        LOG_INF("DLE update requested (delayed for Windows compatibility)");
    }

    /* Request a 6 s supervision timeout so momentary RF attenuation from
     * on-body wear doesn't kill the link. Windows default is ~720 ms which
     * is too short when the antenna is pressed against skin.
     * 600 units × 10 ms = 6000 ms.  Connection interval kept at 7.5–15 ms
     * for low-latency EEG streaming. */
    const struct bt_le_conn_param conn_param = BT_LE_CONN_PARAM_INIT(
        6,    /* interval_min: 6 × 1.25 ms =  7.5 ms */
        12,   /* interval_max: 12 × 1.25 ms = 15.0 ms */
        0,    /* latency: 0 skipped connection events */
        600   /* timeout: 600 × 10 ms = 6 s */
    );
    err = bt_conn_le_param_update(current_conn, &conn_param);
    if (err) {
        LOG_WRN("Supervision timeout update failed (%d) — using host default", err);
    } else {
        LOG_INF("Connection params update requested: interval 7.5–15 ms, supervision 6 s");
    }
}

/* ---------- Connection callbacks ---------- */

static void connected(struct bt_conn *conn, uint8_t err)
{
    if (err) {
        LOG_ERR("Connection failed (err %u)", err);
        return;
    }

    current_conn = bt_conn_ref(conn);
    LOG_INF("Connected");
    /* MTU is negotiated automatically by CONFIG_BT_GATT_AUTO_UPDATE_MTU. */

    /* Schedule DLE 3 s after connect — avoids 0x23 collision with Windows. */
    k_work_schedule(&dle_work, K_SECONDS(3));
}

static void disconnected(struct bt_conn *conn, uint8_t reason)
{
    LOG_INF("Disconnected (reason 0x%02x)", reason);

    /* Cancel any pending DLE request for this connection. */
    k_work_cancel_delayable(&dle_work);

    if (current_conn) {
        bt_conn_unref(current_conn);
        current_conn = NULL;
    }
    eeg_subscribed    = false;
    imu_subscribed    = false;
    status_subscribed = false;

    /* Defer advertising restart to the system workqueue so it runs after
     * the BLE stack finishes tearing down the connection. */
    k_work_submit(&adv_work);
}

BT_CONN_CB_DEFINE(conn_callbacks) = {
    .connected    = connected,
    .disconnected = disconnected,
};

/* ---------- Public API ---------- */

int ble_init(void)
{
    int err = bt_enable(NULL);
    if (err) {
        LOG_ERR("bt_enable failed (err %d)", err);
        return err;
    }

    k_work_init(&adv_work,  adv_work_handler);
    k_work_init(&gain_work, gain_work_handler);
    k_work_init(&test_work, test_work_handler);
    k_work_init(&drl_work,  drl_work_handler);
    k_work_init_delayable(&dle_work, dle_work_handler);

    err = bt_le_adv_start(&adv_param, ad, ARRAY_SIZE(ad),
                           sd, ARRAY_SIZE(sd));
    if (err) {
        LOG_ERR("Advertising start failed (err %d)", err);
        return err;
    }

    LOG_INF("BLE advertising as \"%s\"", CONFIG_BT_DEVICE_NAME);
    return 0;
}

bool ble_is_connected(void)
{
    return current_conn != NULL;
}

bool ble_eeg_subscribed(void)
{
    return eeg_subscribed;
}

int ble_notify_eeg(const uint8_t *data, uint16_t len)
{
    if (current_conn == NULL) {
        return -ENOTCONN;
    }
    if (!eeg_subscribed) {
        return -EACCES;
    }
    return bt_gatt_notify(NULL, &eeg_svc.attrs[2], data, len);
}

bool ble_imu_subscribed(void)
{
    return imu_subscribed;
}

int ble_notify_imu(const struct imu_sample *sample)
{
    if (current_conn == NULL) {
        return -ENOTCONN;
    }
    if (!imu_subscribed) {
        return -EACCES;
    }
    /* Pack as 8-byte little-endian: x_mg, y_mg, z_mg, temp_cdeg (all int16). */
    uint8_t buf[8];
    sys_put_le16((uint16_t)sample->x_mg,    &buf[0]);
    sys_put_le16((uint16_t)sample->y_mg,    &buf[2]);
    sys_put_le16((uint16_t)sample->z_mg,    &buf[4]);
    sys_put_le16((uint16_t)sample->temp_cdeg, &buf[6]);
    return bt_gatt_notify(NULL, &eeg_svc.attrs[5], buf, sizeof(buf));
}

bool ble_status_subscribed(void)
{
    return status_subscribed;
}

/* Read RSSI for the current connection via HCI Read RSSI command.
 * Must be called from a thread context (not ISR, not BLE callback).
 * Returns true and writes rssi_out on success; false on any failure. */
static bool read_rssi(int8_t *rssi_out)
{
    if (!current_conn) {
        return false;
    }
    uint16_t handle;
    if (bt_hci_get_conn_handle(current_conn, &handle) != 0) {
        return false;
    }
    struct net_buf *buf = bt_hci_cmd_create(BT_HCI_OP_READ_RSSI,
                                             sizeof(struct bt_hci_cp_read_rssi));
    if (!buf) {
        return false;
    }
    struct bt_hci_cp_read_rssi *cp = net_buf_add(buf, sizeof(*cp));
    cp->handle = sys_cpu_to_le16(handle);

    struct net_buf *rsp = NULL;
    if (bt_hci_cmd_send_sync(BT_HCI_OP_READ_RSSI, buf, &rsp) != 0) {
        return false;
    }
    struct bt_hci_rp_read_rssi *rp = (void *)rsp->data;
    bool ok = (rp->status == 0);
    if (ok) {
        *rssi_out = rp->rssi;
    }
    net_buf_unref(rsp);
    return ok;
}

int ble_notify_status(uint16_t vbat_mv, uint8_t pct, bool charging, bool error)
{
    if (current_conn == NULL) {
        return -ENOTCONN;
    }
    if (!status_subscribed) {
        return -EACCES;
    }
    /* 5-byte packet:
     *   [0:1]  uint16_t LE  battery voltage mV
     *   [2]    uint8_t      state-of-charge 0–100
     *   [3]    uint8_t      flags: bit0=charging, bit1=error
     *   [4]    int8_t       RSSI in dBm  (127 = unavailable)
     */
    int8_t rssi = 127;   /* 127 = invalid sentinel per BT convention */
    read_rssi(&rssi);

    uint8_t buf[5];
    sys_put_le16(vbat_mv, &buf[0]);
    buf[2] = pct;
    buf[3] = (charging ? BIT(0) : 0) | (error ? BIT(1) : 0);
    buf[4] = (uint8_t)rssi;
    return bt_gatt_notify(NULL, &eeg_svc.attrs[10], buf, sizeof(buf));
}
```

## src/ble.h
```c
#ifndef BLE_H
#define BLE_H

#include <stdbool.h>
#include <stdint.h>
#include "imu.h"

/**
 * Initialize BLE stack and start advertising as "EEG Wearable".
 * Must be called once at startup before any notify calls.
 */
int  ble_init(void);

/** True if a central is currently connected. */
bool ble_is_connected(void);

/** True if the central has subscribed to EEG data notifications. */
bool ble_eeg_subscribed(void);

/**
 * Send raw bytes via the EEG Data NOTIFY characteristic.
 * @param data  Pointer to payload bytes.
 * @param len   Number of bytes (keep <= ATT_MTU - 3 = 244 bytes).
 * @return 0 on success, negative errno on error.
 */
int  ble_notify_eeg(const uint8_t *data, uint16_t len);

/** True if the central has subscribed to IMU data notifications. */
bool ble_imu_subscribed(void);

/**
 * Send one IMU sample via the IMU Data NOTIFY characteristic.
 * Packet: 8 bytes little-endian (x_mg, y_mg, z_mg, temp_cdeg as int16).
 * @return 0 on success, negative errno on error.
 */
int  ble_notify_imu(const struct imu_sample *sample);

/** True if the central has subscribed to Device Status notifications. */
bool ble_status_subscribed(void);

/**
 * Send device status via the Device Status NOTIFY characteristic.
 * Packet format (5 bytes):
 *   [0:1]  uint16_t LE  battery voltage in mV  (0 if VBAT unavailable)
 *   [2]    uint8_t      battery state-of-charge percent  0–100
 *   [3]    uint8_t      PMIC flags:  bit 0 = charging,  bit 1 = error
 *   [4]    int8_t       connection RSSI in dBm  (127 = unavailable)
 *
 * @param vbat_mv   Battery voltage in millivolts.
 * @param pct       State-of-charge 0–100.
 * @param charging  True when nPM1100 CHG pin is asserted (actively charging).
 * @param error     True when nPM1100 ERR pin is asserted (fault condition).
 * @return 0 on success, negative errno on error.
 */
int  ble_notify_status(uint16_t vbat_mv, uint8_t pct, bool charging, bool error);

#endif /* BLE_H */
```

## src/eeg.h
```c
#ifndef EEG_H
#define EEG_H

#include <stdint.h>
#include <stdbool.h>

/* ---------- Channel / hardware constants ----------
 *
 * Physical channel assignment (per schematic):
 *   CH1  IN1P/N  EOG electrode
 *   CH2  IN2P/N  EMG_far electrode
 *   CH3  IN3P/N  EMG_near electrode
 *   CH4  IN4P/N  EEG_L1 (posterior)
 *   CH5  IN5P/N  EEG_L2 (central)
 *   CH6  IN6P/N  EEG_L3 (frontal/lateral)
 *   CH7  IN7P/N  UNUSED — tied to AVDD, powered down
 *   CH8  IN8P/N  BIAS_MEAS — monitors BIAS_IN common-mode (GAIN=1)
 *
 * Reference:  SRB1 pin → reference electrode; MISC1[5]=SRB1=1 connects SRB1
 *             to the inverting input of all channels (referential montage).
 * DRL/BIAS:   BIASOUT pin → patient via protection resistor.
 *             BIAS amplifier input = average(CH1–CH6) via BIAS_SENSP/N=0x3F.
 *             BIASREF_INT=1 in CONFIG3 — internal AVDD/2 reference.
 */

#define EEG_NUM_CHANNELS   8
#define EEG_VREF_MV        4500   /* internal reference: 4.5 V (PD_REFBUF=1) */
#define EEG_GAIN_DEFAULT   24     /* PGA gain for CH1–CH6: GAIN[2:0]=110 */
#define EEG_NUM_GAIN_GROUPS 4     /* number of independently-controlled gain groups */

/* Number of samples packed into one BLE notification */
#define EEG_BATCH_SIZE     8
/* Bytes per BLE packet: 2 (idx) + 4 (one gain byte per group) + 8*8*3 (int24 data) = 198 */
#define EEG_PACKET_BYTES   198

/* ---------- Data types ---------- */

/* One ADS1299 conversion frame */
struct eeg_sample {
    int32_t  ch[EEG_NUM_CHANNELS]; /* raw 24-bit signed, sign-extended to 32 bits */
    uint32_t status;               /* ADS1299 status word bits [23:0] */
};

/* ---------- API ---------- */

/**
 * Initialize the ADS1299.
 *
 * Full startup sequence:
 *   PWDN↑ → RESET pulse → SDATAC → ID verify (0x3E) →
 *   CONFIG3/1/2 → CHnSET × 8 → BIAS_SENSP/N → MISC1 →
 *   DRDY interrupt → START↑ → RDATAC
 *
 * @return 0 on success, negative errno on failure.
 */
int  eeg_init(void);

/** True if init succeeded and the ADS1299 is streaming at 250 SPS. */
bool eeg_is_ready(void);

/**
 * Convert a raw 24-bit value to microvolts using the current PGA gain.
 * µV = raw × VREF_µV / GAIN / 2^23
 */
int32_t eeg_raw_to_uv(int32_t raw);

/**
 * Drain up to @count samples from the internal ring buffer into @out.
 * Called from the main loop — not ISR-safe.
 * @return number of complete samples copied (0 if fewer than @count available).
 */
int eeg_read(struct eeg_sample *out, int count);

/**
 * Pack @EEG_BATCH_SIZE samples into a 198-byte BLE notification payload.
 *
 * Packet layout:
 *   [0–1]   sample index uint16 LE  (gap detection on the Python side)
 *   [2–5]   current PGA gain bytes (one per group, groups 0–3)
 *   [6–197] 8 samples × 8 channels × 3 bytes int24 big-endian
 *
 * @param batch   Array of exactly EEG_BATCH_SIZE samples (from eeg_read).
 * @param packet  Output buffer of EEG_PACKET_BYTES bytes.
 */
void eeg_pack_batch(const struct eeg_sample batch[EEG_BATCH_SIZE],
                    uint8_t packet[EEG_PACKET_BYTES]);

/**
 * Change PGA gain for one channel group.
 *
 * Groups:
 *   0 → CH1        (EOG)
 *   1 → CH2, CH3   (EMG / ECG)
 *   2 → CH4, CH6   (EEG L1 / L3)
 *   3 → CH5        (EEG L2)
 *
 * Issues SDATAC → WREG × n → RDATAC (~60 µs dead time).
 * Must be called from the system workqueue, not a BLE callback.
 *
 * @param group  0–3
 * @param gain   One of: 1, 2, 4, 6, 8, 12, 24.
 * @return 0 on success, -EINVAL for bad group or gain.
 */
int eeg_set_group_gain(uint8_t group, uint8_t gain);

/** Returns the current PGA gain for the given group (0–3). */
uint8_t eeg_get_group_gain(uint8_t group);

/**
 * Switch ADS1299 CH1–CH6 between normal electrode input and the internal
 * ~1 Hz calibration square wave (CONFIG2 INT_CAL=1, CAL_AMP=00 → ±1.875 mV).
 * Gains are preserved across the switch.  CH7 stays powered-down; CH8 BIAS_MEAS
 * is unaffected.  Must be called from the system workqueue, not a BLE callback.
 */
void eeg_set_test_mode(bool enable);

/** True if eeg_set_test_mode(true) has been called and not yet reversed. */
bool eeg_test_mode_active(void);

/**
 * Enable or disable the DRL (Driven Right Leg) circuit.
 * enable=true  → BIAS_SENSP/SENSN = 0x3F (CH1–CH6 feed the BIAS amplifier → active DRL)
 * enable=false → BIAS_SENSP/SENSN = 0x00 (BIAS amplifier still powered but drives nothing)
 * Must be called from the system workqueue, not a BLE callback.
 */
void eeg_set_drl(bool enable);

/** True if DRL is currently active (default: true after eeg_init). */
bool eeg_drl_active(void);

/* ---------- Power management ---------- */

/**
 * Stop ADS1299 conversions by deasserting START.
 * Analog front-end stays powered (~2-3 mA). DRDY stops toggling.
 * Call eeg_start() to resume without re-init.
 */
void eeg_stop(void);

/**
 * Resume conversions after eeg_stop().
 * Reasserts START — RDATAC still active, resumes within one conversion period (~4 ms).
 */
void eeg_start(void);

/**
 * Power down ADS1299 completely (~65 µA).
 * Must be called after eeg_stop(). Full re-init required via eeg_powerup().
 */
void eeg_powerdown(void);

/**
 * Power up ADS1299 after eeg_powerdown().
 * Deasserts PWDN, issues RESET pulse, replays full register configuration.
 * @return 0 on success, negative errno on failure.
 */
int eeg_powerup(void);

#endif /* EEG_H */
```

## src/imu.h
```c
#ifndef IMU_H
#define IMU_H

#include <stdint.h>
#include <stdbool.h>

/* ---------- Operating modes (set via DTS power-mode property) ----------
 *
 * These are documented here for reference — the active mode is baked
 * into the DTS node (power-mode = <0> means LP Mode 1 below).
 *
 * power-mode | Name            | Resolution | Current @ 50 Hz | Noise (RMS)
 * -----------|-----------------|------------|-----------------|------------
 *     0      | LP Mode 1       | 12-bit     | ~3   µA         | 4.5 mg     ← selected
 *     1      | LP Mode 2       | 14-bit     | ~20  µA         | 2.4 mg
 *     2      | LP Mode 3       | 14-bit     | ~35  µA         | 1.8 mg
 *     3      | LP Mode 4       | 14-bit     | ~63  µA         | 1.3 mg
 *     4      | High-Performance| 14-bit     | ~90  µA         | 0.09 mg/√Hz
 *
 * Power-down (ODR = 0): 50 nA — use when EEG is also idle.
 *
 * Full-scale options (set via DTS range property):
 *   range = <2>   → ±2  g   0.976 mg/LSB (LP1) — selected, enough for head motion
 *   range = <4>   → ±4  g   1.952 mg/LSB
 *   range = <8>   → ±8  g   3.904 mg/LSB
 *   range = <16>  → ±16 g   7.808 mg/LSB
 *
 * ODR options (set via DTS odr property, in Hz):
 *   1, 12, 25, 50, 100, 200, 400, 800, 1600
 *   Selected: 50 Hz — fast enough for head motion, low power.
 *
 * Motion detection (SENSOR_TRIG_MOTION):
 *   Wakes from sleep when acceleration exceeds WAKE_UP_THS on any axis.
 *   Useful for duty-cycling: sleep the EEG AFE when no head motion detected.
 */

/* ---------- Data types ---------- */

/* One IMU sample — transmitted over BLE and used by Python visualisations. */
struct imu_sample {
    int16_t x_mg;      /* X acceleration in milligravity (1g = 1000) */
    int16_t y_mg;      /* Y acceleration in milligravity             */
    int16_t z_mg;      /* Z acceleration in milligravity             */
    int16_t temp_cdeg; /* Die temperature in hundredths of °C        */
};

/* ---------- API ---------- */

/**
 * Initialize the LIS2DW12 and configure the motion-detection trigger.
 * Must be called after the Zephyr sensor subsystem is ready (i.e. in main).
 * @return 0 on success, negative errno on failure.
 */
int imu_init(void);

/**
 * Read one sample from the LIS2DW12 (blocking, ~1 I2C transaction).
 * @param out  Pointer to sample struct to fill.
 * @return 0 on success, negative errno on failure.
 */
int imu_read(struct imu_sample *out);

/** True if the IMU device is ready and initialised. */
bool imu_is_ready(void);

#endif /* IMU_H */
```

## src/pmic.c
```c
#include "pmic.h"

#include <zephyr/kernel.h>
#include <zephyr/drivers/gpio.h>
#include <zephyr/logging/log.h>

LOG_MODULE_REGISTER(pmic, LOG_LEVEL_INF);

/* DTS aliases resolve to gpio-keys nodes on P0.02 and P0.03.
 * Both are declared GPIO_ACTIVE_LOW | GPIO_PULL_UP in the board DTS, so:
 *   gpio_pin_configure_dt(..., GPIO_INPUT) adds direction; pull/polarity come from dt_flags.
 *   gpio_pin_get_dt(...) returns 1 when the pin is asserted (physically LOW). */
static const struct gpio_dt_spec pmic_err_gpio =
    GPIO_DT_SPEC_GET(DT_ALIAS(pmic_err), gpios);
static const struct gpio_dt_spec pmic_chg_gpio =
    GPIO_DT_SPEC_GET(DT_ALIAS(pmic_chg), gpios);

int pmic_init(void)
{
    if (!gpio_is_ready_dt(&pmic_err_gpio)) {
        LOG_ERR("PMIC_ERR GPIO (P0.02) not ready");
        return -ENODEV;
    }
    if (!gpio_is_ready_dt(&pmic_chg_gpio)) {
        LOG_ERR("PMIC_CHG GPIO (P0.03) not ready");
        return -ENODEV;
    }

    int ret = gpio_pin_configure_dt(&pmic_err_gpio, GPIO_INPUT);
    if (ret) {
        LOG_ERR("PMIC_ERR configure failed (%d)", ret);
        return ret;
    }
    ret = gpio_pin_configure_dt(&pmic_chg_gpio, GPIO_INPUT);
    if (ret) {
        LOG_ERR("PMIC_CHG configure failed (%d)", ret);
        return ret;
    }

    LOG_INF("PMIC GPIO ready  ERR=P0.02  CHG=P0.03  (active-low, pull-up)");
    return 0;
}

bool pmic_is_charging(void)
{
    /* Returns 1 (asserted) when P0.03 is pulled LOW by the nPM1100 charger. */
    return gpio_pin_get_dt(&pmic_chg_gpio) > 0;
}

bool pmic_is_error(void)
{
    /* Returns 1 (asserted) when P0.02 is pulled LOW by the nPM1100 fault logic. */
    return gpio_pin_get_dt(&pmic_err_gpio) > 0;
}
```

## src/pmic.h
```c
#ifndef PMIC_H
#define PMIC_H

#include <stdbool.h>

/* ---------- Hardware notes ----------
 *
 * nPM1100 status outputs (both open-drain, active-low, pulled up on board):
 *
 *   P0.02  PMIC_ERR  — asserted (LOW) on charging fault:
 *                       over-voltage, over-temperature, charge-timeout, or
 *                       reverse-current.  Clears when VBUS disconnects/reconnects.
 *
 *   P0.03  PMIC_CHG  — asserted (LOW) while the charger is actively pushing
 *                       current into the cell.  De-asserts when the cell is full
 *                       (CV phase complete) OR when VBUS is absent.
 *
 * Limitation: CHG=HIGH is ambiguous — it means either "fully charged" or
 * "USB disconnected".  The nPM1100 has no VBUS-detect output pin, so the
 * firmware cannot distinguish these two states.  Future PCB revision should
 * add a VBUS sense pin (e.g. via voltage divider or simple comparator).
 *
 * USB D+/D-: connected only to the nPM1100 for BC1.2 charger detection
 * (SDP=100mA, DCP/CDP=500mA).  Handled autonomously by the PMIC — the MCU
 * has no access to the detected charger type.
 */

/**
 * Configure P0.02 (PMIC_ERR) and P0.03 (PMIC_CHG) as GPIO inputs.
 * Pull-ups are specified in the devicetree node; this just enables the pin.
 * @return 0 on success, negative errno on failure.
 */
int pmic_init(void);

/** True while the nPM1100 is actively charging (PMIC_CHG pin asserted / LOW). */
bool pmic_is_charging(void);

/** True when the nPM1100 has flagged a charging fault (PMIC_ERR pin asserted / LOW). */
bool pmic_is_error(void);

#endif /* PMIC_H */
```

## src/vbat.c
```c
#include "vbat.h"

#include <zephyr/kernel.h>
#include <zephyr/drivers/adc.h>
#include <zephyr/logging/log.h>

LOG_MODULE_REGISTER(vbat, LOG_LEVEL_INF);

/* ---------- ADC ---------- */

/* ADC_DT_SPEC_GET requires a consumer node with io-channels pointing to the
 * ADC channel. vbat_sense in DTS has io-channels = <&adc 0>; channel@0 holds
 * gain/reference/pin config. The macro reads both through the phandle. */
static const struct adc_dt_spec vbat_adc = ADC_DT_SPEC_GET(DT_NODELABEL(vbat_sense));

static int16_t        adc_buf;
static struct adc_sequence adc_seq = {
    .buffer      = &adc_buf,
    .buffer_size = sizeof(adc_buf),
};

/* ---------- Resistor divider ---------- */

/* R_top = 2 MΩ, R_bot = 1 MΩ → ratio = 1/3.
 * V_bat = V_adc × (R_top + R_bot) / R_bot = V_adc × 3. */
#define DIVIDER_FULL_OHMS   3000000UL
#define DIVIDER_OUT_OHMS    1000000UL

/* ---------- LiPo discharge curve ----------
 *
 * Lookup table: battery voltage (mV) → state of charge (%).
 * Based on the typical single-cell LiPo discharge curve.
 * Linear interpolation is used between points.
 *
 * 4200 mV = fully charged (charger cutoff)
 * 3000 mV = empty (protect circuit cutoff for small cells)
 */
static const struct {
    uint32_t mv;
    uint8_t  pct;
} lipo_curve[] = {
    { 4200, 100 },
    { 4150,  97 },
    { 4110,  94 },
    { 4080,  91 },
    { 4020,  85 },
    { 3980,  79 },
    { 3950,  73 },
    { 3910,  65 },
    { 3870,  57 },
    { 3830,  50 },
    { 3790,  42 },
    { 3750,  35 },
    { 3710,  27 },
    { 3670,  20 },
    { 3610,  13 },
    { 3490,   6 },
    { 3300,   2 },
    { 3000,   0 },
};

static uint8_t mv_to_percent(uint32_t mv)
{
    if (mv >= lipo_curve[0].mv) {
        return 100;
    }
    for (size_t i = 1; i < ARRAY_SIZE(lipo_curve); i++) {
        if (mv >= lipo_curve[i].mv) {
            /* Linear interpolation between entry i-1 and i. */
            uint32_t v_hi = lipo_curve[i - 1].mv;
            uint32_t v_lo = lipo_curve[i].mv;
            uint8_t  p_hi = lipo_curve[i - 1].pct;
            uint8_t  p_lo = lipo_curve[i].pct;
            return p_lo + (uint8_t)((mv - v_lo) * (p_hi - p_lo) / (v_hi - v_lo));
        }
    }
    return 0;
}

/* ---------- Public API ---------- */

int vbat_init(void)
{
    if (!adc_is_ready_dt(&vbat_adc)) {
        LOG_ERR("VBAT ADC device not ready");
        return -ENODEV;
    }
    int ret = adc_channel_setup_dt(&vbat_adc);
    if (ret) {
        LOG_ERR("ADC channel setup failed (err %d)", ret);
        return ret;
    }
    ret = adc_sequence_init_dt(&vbat_adc, &adc_seq);
    if (ret) {
        LOG_ERR("ADC sequence init failed (err %d)", ret);
        return ret;
    }
    LOG_INF("VBAT ADC ready (P1.13 = AIN6, gain=1/4, ref=0.6 V internal)");
    return 0;
}

int vbat_read_mv(uint32_t *mv_out)
{
    int ret = adc_read(vbat_adc.dev, &adc_seq); // Triggers the ADC to sample the voltage on the pin and stores into adc buffer
    if (ret) {
        return ret;
    }

    /* adc_raw_to_millivolts_dt converts the raw count to the voltage
     * seen at the ADC pin using the gain and reference from the DT spec. */
    int32_t val_mv = adc_buf;
    ret = adc_raw_to_millivolts_dt(&vbat_adc, &val_mv);
    if (ret) {
        return ret;
    }

    /* Scale back up through the resistor divider. */
    *mv_out = (uint32_t)val_mv * DIVIDER_FULL_OHMS / DIVIDER_OUT_OHMS;
    return 0;
}

int vbat_percent(uint8_t *pct_out)
{
    uint32_t mv;
    int ret = vbat_read_mv(&mv);
    if (ret) {
        return ret;
    }
    *pct_out = mv_to_percent(mv);
    return 0;
}
```
