## nRF54L15/boards/rishabh/eeg_wearable/Kconfig.eeg_wearable
```kconfig
config BOARD_EEG_WEARABLE
	select SOC_NRF54L15_CPUAPP if BOARD_EEG_WEARABLE_NRF54L15_CPUAPP
	select SOC_NRF54L15_CPUFLPR if \
		BOARD_EEG_WEARABLE_NRF54L15_CPUFLPR || \
		BOARD_EEG_WEARABLE_NRF54L15_CPUFLPR_XIP
```

## nRF54L15/boards/rishabh/eeg_wearable/board.yml
```yaml
board:
  name: eeg_wearable
  vendor: rishabh
  socs:
  - name: nrf54l15
    variants:
    - name: xip
      cpucluster: cpuflpr
```
